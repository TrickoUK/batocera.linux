## package/batocera/emulators/gopher64/Config.in
```kconfig
config BR2_PACKAGE_GOPHER64
	bool "gopher64"
	depends on BR2_PACKAGE_HOST_RUSTC_TARGET_ARCH_SUPPORTS
	select BR2_PACKAGE_HOST_RUSTC
	select BR2_PACKAGE_BATOCERA_VULKAN
	help
	  gopher64 is a cross-platform, RetroAchievements-capable Nintendo 64
	  emulator written in Rust. Vendors/statically links its own SDL3
	  (not this fork's own SDL3 package) and uses Vulkan (parallel-rdp)
	  for rendering.

	  An additional, optional core for the n64 system alongside
	  mupen64plus.

	  https://github.com/gopher64/gopher64
```

## package/batocera/emulators/retroarch/libretro/libretro-geolith/Config.in
```kconfig
config BR2_PACKAGE_LIBRETRO_GEOLITH
    bool "libretro-geolith"
    help
      A libretro Neo Geo emulator core, using the TerraOnion .NEO rom format.

      http://www.libretro.com
```

## package/batocera/emulators/standalone-mame/Config.in
```kconfig
config BR2_PACKAGE_STANDALONE_MAME
	bool "standalone-mame (upstream MAME)"
	depends on BR2_INSTALL_LIBSTDCPP
	select BR2_PACKAGE_EXPAT
	select BR2_PACKAGE_FONTCONFIG
	select BR2_PACKAGE_GLM
	select BR2_PACKAGE_JPEG
	select BR2_PACKAGE_LIBPNG
	select BR2_PACKAGE_PUGIXML
	select BR2_PACKAGE_PULSEAUDIO
	select BR2_PACKAGE_RAPIDJSON
	select BR2_PACKAGE_SDL2
	select BR2_PACKAGE_SDL2_TTF
	select BR2_PACKAGE_SQLITE
	select BR2_PACKAGE_UTF8PROC
	select BR2_PACKAGE_ZLIB
	select BR2_PACKAGE_ZSTD
	help
	  standalone-mame: the real, current upstream mamedev/mame release,
	  built as a second standalone (non-libretro) MAME binary alongside
	  this fork's existing "mame" package (which is actually a
	  GroovyMAME build, not stock MAME - see
	  package/batocera/emulators/mame/mame.mk). Opt-in alternate core
	  for the arcade `mame` and `neogeo` ES systems only - no MESS/
	  computer system support, no Switchres/CRT support, and gun
	  support is degraded versus groovy-mame's out-of-tree patches.
	  See ADD-STANDALONE-MAME.md.

	  https://mamedev.org
```
