## package/batocera/emulators/ares/Config.in
```kconfig
config BR2_PACKAGE_ARES
	bool "ares"
	depends on BR2_x86_64
	depends on BR2_INSTALL_LIBSTDCPP && BR2_PACKAGE_HAS_LIBGL && BR2_TOOLCHAIN_GCC_AT_LEAST_13
	select BR2_PACKAGE_LIBGTK3
	select BR2_PACKAGE_SDL3
	select BR2_PACKAGE_XLIB_LIBX11
	select BR2_PACKAGE_XLIB_LIBXRANDR
	select BR2_PACKAGE_LIBRASHADER
	help
	  Multi-system emulator descended from higan/bsnes. This fork builds
	  it scoped to Nintendo 64, Super Nintendo/Super Famicom, NES/Famicom,
	  Mega Drive/Genesis (also covers 32X and Mega CD), PC Engine/
	  TurboGrafx-16, and Master System only
	  (ARES_CORES=n64;sfc;fc;md;pce;ms) rather than its full system list.

	  https://ares-emu.net

comment "ares needs a toolchain w/ C++23, OpenGL, GTK3"
	depends on BR2_x86_64
	depends on !BR2_INSTALL_LIBSTDCPP || !BR2_PACKAGE_HAS_LIBGL || !BR2_TOOLCHAIN_GCC_AT_LEAST_13
```

## package/batocera/emulators/namco2x/Config.in
```kconfig
config BR2_PACKAGE_NAMCO2X
	bool "namco2x"
	depends on BR2_x86_64
	depends on BR2_PACKAGE_HAS_LIBGL
	select BR2_PACKAGE_SDL2
	select BR2_PACKAGE_SDL2_OPENGL
	select BR2_PACKAGE_SDL2_WAYLAND if BR2_PACKAGE_WAYLAND
	select BR2_PACKAGE_ZLIB
	select BR2_PACKAGE_BATOCERA_LAUNCH_NAMCO2X if BR2_PACKAGE_BATOCERA_LAUNCH
	help
	  Namco 2x Systems: decompiled/recompiled Namco System 21/22/23
	  games (Time Crisis, Time Crisis II, Rave Racer, Ace Driver,
	  Dirt Dash, Tokyo Wars, Cyber Commando, Prop Cycle, Cyber Sled)
	  as native SDL2 + OpenGL binaries.
	  Installs the prebuilt release binaries: they contain code
	  translated from the MAME ROM sets, so this is fork-only and
	  must never go upstream.

	  https://github.com/spacestate1/namco22-decompile

comment "namco2x needs OpenGL"
	depends on BR2_x86_64
	depends on !BR2_PACKAGE_HAS_LIBGL
```

## package/batocera/emulators/retroarch/libretro/libretro-supermodel/Config.in
```kconfig
config BR2_PACKAGE_LIBRETRO_SUPERMODEL
    bool "libretro-supermodel"
    depends on BR2_INSTALL_LIBSTDCPP
    select BR2_PACKAGE_ZLIB
    help
      A libretro port of Supermodel, the Sega Model 3 arcade emulator.
      Needs OpenGL 4.1 (New3D) and an OpenGL-capable RetroArch video driver.

      https://github.com/libretro/Libretro-Supermodel
```

## package/batocera/libraries/librashader/Config.in
```kconfig
config BR2_PACKAGE_LIBRASHADER
	bool "librashader"
	depends on BR2_PACKAGE_HOST_RUSTC_TARGET_ARCH_SUPPORTS
	select BR2_PACKAGE_HOST_RUSTC
	help
	  A preprocessor, compiler, and runtime for RetroArch "slang" shaders,
	  reimplemented in Rust. Provides shader support to any consumer
	  that dynamically loads librashader.so at runtime (e.g. ares).

	  https://github.com/SnowflakePowered/librashader
```

## python-src/batocera-launch-namco2x/Config.in
```kconfig
config BR2_PACKAGE_BATOCERA_LAUNCH_NAMCO2X
	bool
	depends on BR2_PACKAGE_PYTHON_BATOCERA_COMMON
	depends on BR2_PACKAGE_BATOCERA_LAUNCH
```
